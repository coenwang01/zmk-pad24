## boards/shields/kawvin_46/Kconfig.shield
```kconfig
# Copyright (c) 2021 The ZMK Contributors
# SPDX-License-Identifier: MIT

config SHIELD_KAWVIN_PAD24
    def_bool $(shields_list_contains,kawvin_pad24)
```
